## components/app-display/Kconfig
```kconfig
menu "Application display config"

config APP_DISPLAY_UPDATE_INTERVAL
    int "Update interval for display"
    default 5000
    range 1000 600000
endmenu
```

## components/app-mqtt/Kconfig
```kconfig
menu "Application MQTT config"
config MQTT_BROKER_HOST
    string "Broker host"
    default "iot-server.tk"
    help
        URL of the broker to connect to

config MQTT_BROKER_USER
    string "MQTT username"
    default "root"

config MQTT_BROKER_PASS
    string "MQTT password"
    default ""

config MQTT_BROKER_PORT
    int "MQTT port"
    default 1883

config MQTT_BROKER_PORT
    int "MQTT port"
    default 1883

config MQTT_BROKER_BASE_TOPIC
    string  "MQTT base topic"
    default "/hwt/"

endmenu
```

## components/app-rf/Kconfig
```kconfig
menu "NRF24L01 config"

config APP_RF_CE_PIN
    int "CE pin"
    default 2

config APP_RF_CSN_PIN
    int "CSN pin"
    default 4

config APP_RF_CHANNEL
    int "Channel"
    default 80
    range 0 124

config APP_RF_PA_LEVEL
    int "Power amplifier level"
    default 3
    range 0 3
    help
        0 - Min
        1 - Low
        2 - High
        3 - Max

config APP_RF_DATA_RATE
    int "Data rate"
    default 2
    range 0 2
    help
        0 - 1MBPS
        1 - 2MBPS
        2 - 250KBPS
config APP_RF_MAX_LOSSS_MESSAGES_BEFORE_LOSE_SIGNAL
    int "Max lost messages before lose signal"
    default 5
    range 1 100
endmenu
```

## components/app-sensors/Kconfig
```kconfig
menu "Application sensors config"

config APP_BME280_UPDATE_INTERVAL
    int "Update interval for BME280 sensor"
    default 5000
    range 1000 600000

config APP_MHZ19_UPDATE_INTERVAL
    int "Update interval for MHZ19 sensor"
    default 10000
    range 2000 600000

config APP_BH1750_UPDATE_INTERVAL
    int "Update interval for BH1750 sensor"
    default 1500
    range 500 60000
endmenu
```

## components/app-time/Kconfig
```kconfig
menu "Application time config"

config TZ_INFO
    string "Timezone info"
    default "EET-2EEST,M3.5.0/3,M10.5.0/4"
    help
        https://remotemonitoringsystems.ca/time-zone-abbreviations.php
endmenu
```

## components/app-wifi/Kconfig
```kconfig
menu "Application WiFi config"
config DEFAULT_WIFI_SSID
    string  "DEFAULT_WIFI_SSID"
    default "dimaPC"

config DEFAULT_WIFI_PASS
    string  "DEFAULT_WIFI_PASS"
    default "12345678"
endmenu
```

## components/bh1750/Kconfig
```kconfig
menu "BH1750"

config BH1750_I2C_SDA_GPIO
    int "BH1750 SDA GPIO"
    default 21

config BH1750_I2C_SCL_GPIO
    int "BH1750 SCL GPIO"
    default 22

endmenu
```

## components/bme280/Kconfig
```kconfig
menu "BME280"

config BME280_I2C_SDA_GPIO
    int "BME280 SDA GPIO"
    default 21

config BME280_I2C_SCL_GPIO
    int "BME280 SCL GPIO"
    default 22

endmenu
```

## components/i2cdev/Kconfig
```kconfig
menu "I2C"

config I2CDEV_TIMEOUT
    int "I2C transaction timeout, milliseconds"
    default 2000
    range 100 5000
    
endmenu
```

## components/mh-z19/Kconfig
```kconfig
menu "MH-Z19 CO2 Sensor"

config MHZ19_UART_NUM
    hex "uart num"
    default 1

config MHZ19_UART_RXD_PIN
    int "RX gpio"
    default 33
    help
        GPIO pin connected to sensor RX line. This pin can be R/O (>=34).
        
config MHZ19_UART_TXD_PIN
    int "TX gpio"
    default 32
    help
        GPIO pin connected to sensor TX line.
endmenu
```

## main/Kconfig
```kconfig
menu "Application config"

config APP_RF_SENSORS_COUNT
    int "Max connected sensors by radio module"
    default 5
    range 1 5

config APP_BME280_UPDATE_INTERVAL
    int "Update interval for BME280 sensor"
    default 5000
    range 1000 600000

config APP_MHZ19_UPDATE_INTERVAL
    int "Update interval for MHZ19 sensor"
    default 10000
    range 2000 600000

config APP_BH1750_UPDATE_INTERVAL
    int "Update interval for BH1750 sensor"
    default 1500
    range 500 60000

config APP_DISPLAY_UPDATE_INTERVAL
    int "Update interval for display"
    default 5000
    range 1000 600000

config DEFAULT_WIFI_SSID
    string  "DEFAULT_WIFI_SSID"
    default "dimaPC"

config DEFAULT_WIFI_PASS
    string  "DEFAULT_WIFI_PASS"
    default "12345678"

config MQTT_BROKER_URL
    string "Broker URL"
    default "mqtt://127.0.0.1"
    help
        URL of the broker to connect to
config TZ_INFO
    string "Timezone info"
    default "EET-2EEST,M3.5.0/3,M10.5.0/4"
    help
        https://remotemonitoringsystems.ca/time-zone-abbreviations.php
endmenu
```
